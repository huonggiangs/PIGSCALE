## sdkconfig.defaults
```kconfig
# ============================================================
# sdkconfig.defaults — ESP32-P4 Excavator Scale V3
# ============================================================

# Target
CONFIG_IDF_TARGET="esp32p4"

# PSRAM (32MB Octal)
CONFIG_SPIRAM=y
CONFIG_SPIRAM_MODE_OCT=y
CONFIG_SPIRAM_SPEED_80M=y
CONFIG_SPIRAM_USE_MALLOC=y
CONFIG_SPIRAM_MALLOC_ALWAYSINTERNAL=16384

# Flash
CONFIG_ESPTOOLPY_FLASHSIZE_16MB=y
CONFIG_ESPTOOLPY_FLASHFREQ_80M=y
CONFIG_PARTITION_TABLE_CUSTOM=y
CONFIG_PARTITION_TABLE_CUSTOM_FILENAME="partitions.csv"

# FreeRTOS
CONFIG_FREERTOS_HZ=1000
CONFIG_FREERTOS_UNICORE=n

# Log level
CONFIG_LOG_DEFAULT_LEVEL_INFO=y
CONFIG_LOG_MAXIMUM_LEVEL_DEBUG=y

# LVGL
CONFIG_LV_MEM_CUSTOM=y
CONFIG_LV_MEM_CUSTOM_ALLOC=heap_caps_malloc
CONFIG_LV_COLOR_DEPTH=16
CONFIG_LV_USE_PERF_MONITOR=y

# Ethernet (IP101 PHY)
CONFIG_ETH_USE_ESP32_EMAC=y
CONFIG_ETH_PHY_IP101=y
CONFIG_ETH_RMII_CLK_INPUT=y

# Wi-Fi
CONFIG_ESP_WIFI_ENABLED=y

# Stack sizes
CONFIG_ESP_MAIN_TASK_STACK_SIZE=8192
```
